//******************************************************************************
//! @file $RCSfile: can128_iar_can_bootloader_link.xcl,v $
//!
//! Copyright (c) 2009 Atmel.
//!
//! Use of this program is subject to Atmel's End User License Agreement.
//! Please read file license.txt for copyright notice.
//!
//! @brief XLINK command file for the ICCAVR C-compiler using the --cpu=can128,
//!        -ms options. Segments are defined for an AT90CAN128 whithout XSRAM. 
//!        This file contains resource definitions for:
//!           - "iar_can_bootloader" project
//!           - "AT90CAN128" device
//!
//! This file has been validated with:
//!     - AVRStudio 4.15.623,
//!     - IAR C/C++ Compiler for AVR 5.20.1 (5.20.1.50092)
//!
//! @version $Revision: 3.00 $ $Name: jtellier $
//!
//! Note: The '_..X_' prefix is used by C-SPY as an indication that the label
//! should not be displayed in the dissassembly window.
//!
//! @todo
//! @bug
//******************************************************************************

//==============================================================================
// SIZE CONSTANTES DEFINITION (in hexadecimal)
//==============================================================================

// Code (flash) segments
//----------------------
-D_..X_INTVEC_SIZE=0    // No Interrupt vector is used (excepted for RESET)

-D_..X_FLASH_TEND=FF    // End of tiny flash memory
-D_..X_FLASH_NEND=FFFF  // End of near flash memory
-D_..X_FLASH_END=1FFFF   // End of flash memory

-D_..X_FLASH_BOOT=1F000        // Beginning of Boot section (size = 4K Bytes)
-D_..X_FLASH_BOOT_CONF=1FFF6   // Last page: (END OF FLASH_BOOT - BOOT_CONF size)

// Data (SRAM, external ROM or external NV RAM) memory
//----------------------------------------------------
-D_..X_SRAM_BASE=100    // Start of ram memory
-D_..X_SRAM_TEND=100    // End of tiny ram memory
-D_..X_SRAM_END=10FF    // End of ram memory

// Internal EEPROM
//----------------
-D_..X_EEPROM_END=FFF   // End of eeprom memory


//==============================================================================
// DEFINE CPU
//==============================================================================
-ca90

// ............

// RESET VECTOR SEGMENT
//---------------------------------------------------------
-Z(CODE)INTVEC=_..X_FLASH_BOOT-_..X_FLASH_END

// SPECIFIC FOR THE API FLASH FUNCTION (Must be just after INTVEC)
// CARE: The page of API functions must differ from BOOT_CONF page
//---------------------------------------------------------
-Z(CODE)API_FLASH=_..X_FLASH_BOOT-_..X_FLASH_END

// COMPILER SEGMENTS :SWITCH, INITTAB, DIFUNCT
//---------------------------------------------------------
-Z(CODE)SWITCH,INITTAB,DIFUNCT=_..X_FLASH_BOOT-_..X_FLASH_END

// ............

// TINY OBJECT : for object declared with __tinyflash keyword
//----------------------------------------------------------
-Z(CODE)TINY_F=_..X_FLASH_BOOT-_..X_FLASH_END

// NEAR OBJECT : for object declared with __flash keyword 
//----------------------------------------------------------
-Z(CODE)NEAR_F=_..X_FLASH_BOOT-_..X_FLASH_END

// FAR OBJECT : for object declared with __farflash keyword 
//----------------------------------------------------------
-Z(CODE)FAR_F=_..X_FLASH_BOOT-_..X_FLASH_END

// ............

// NEAR FUNCTION OBJECT : for all functions in __nearfunc 
//----------------------------------------------------------
-Z(CODE)CODE=_..X_FLASH_BOOT-_..X_FLASH_END

// ............

// BOOT_CONF MEMORY
//----------------------------------------------------------
-Z(CODE)BOOT_CONF=_..X_FLASH_BOOT_CONF-_..X_FLASH_END

// ............

// INIT SEGMENTS
//----------------------------------------------------------
-Z(CODE)TINY_ID,NEAR_ID=_..X_FLASH_BOOT-_..X_FLASH_END

// ............

// DATA SEGMENTS DEFINITION
//----------------------------------------------------------
-Z(DATA)TINY_I,TINY_Z,TINY_N=_..X_SRAM_BASE-_..X_SRAM_TEND
-Z(DATA)NEAR_I,NEAR_Z=_..X_SRAM_BASE-_..X_SRAM_END

// ............

// INTERNAL EEPROM 
//----------------------------------------------------------
-Z(XDATA)EEPROM_I,EEPROM_N=0-_..X_EEPROM_END

// ............

// STACK SEGMENTS DEFINITION
//----------------------------------------------------------
-Z(DATA)CSTACK+_..X_CSTACK_SIZE=_..X_SRAM_BASE
-Z(DATA)HEAP+_..X_HEAP_SIZE=_..X_SRAM_BASE
-Z(DATA)RSTACK+_..X_RSTACK_SIZE=_..X_SRAM_BASE


// Suppress one warning which is not relevant for this processor 
-w29

// Code will now reside in file aout.a90 or aout.d90, unless -o is specified
// .d90 is the default if debug system is linked (option -r)
// .a90 is the default without debugging. Default format is -Fmotorola
